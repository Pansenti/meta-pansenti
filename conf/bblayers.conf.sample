## conf/bblayers.conf.sample
```bitbake
# LAYER_CONF_VERSION is increased each time build/conf/bblayers.conf
# changes incompatibly
LCONF_VERSION = "6"

BBPATH = "${TOPDIR}"
BBFILES ?= ""

BBLAYERS ?= " \
  /home/scott/poky-dora/meta \
  /home/scott/poky-dora/meta-yocto \
  /home/scott/poky-dora/meta-openembedded/meta-oe \
  /home/scott/poky-dora/meta-openembedded/meta-networking \
  /home/scott/poky-dora/meta-fsl-arm \
  /home/scott/poky-dora/meta-fsl-arm-extra \
  /home/scott/poky-dora/meta-gumstix \
  /home/scott/poky-dora/meta-beagleboard/common-bsp \
  /home/scott/poky-dora/meta-pansenti \
  "

BBLAYERS_NON_REMOVABLE ?= " \
  /home/scott/poky-dora/meta \
  /home/scott/poky-dora/meta-yocto \
  "
```

## conf/layer.conf
```bitbake
# We have a conf and classes directory, append to BBPATH
BBPATH .= ":${LAYERDIR}"

# We have a recipes directory, add to BBFILES
BBFILES += "${LAYERDIR}/recipes*/*/*.bb ${LAYERDIR}/recipes*/*/*.bbappend"

BBFILE_COLLECTIONS += "meta-pansenti"
BBFILE_PATTERN_meta-pansenti := "^${LAYERDIR}/"
BBFILE_PRIORITY_meta-pansenti = "16"
```
